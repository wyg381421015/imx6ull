## u-boot-2020.04/board/freescale/mx6ull_ygst/Kconfig
```kconfig
if TARGET_MX6ULL_YGST

config SYS_BOARD
	default "mx6ull_ygst"

config SYS_VENDOR
	default "freescale"

config SYS_CONFIG_NAME
	default "mx6ull_ygst"

config SYS_TEXT_BASE
	default 0x87800000
endif
```
